## app/boards/shields/dygma_lower/Kconfig.shield
```kconfig
# Copyright (c) 2020 Pete Johanson
# SPDX-License-Identifier: MIT

config SHIELD_dygma_left
    def_bool $(shields_list_contains,dygma_left)

config SHIELD_dygma_lower_RIGHT
    def_bool $(shields_list_contains,dygma_lower_right)
```
